// Integrity of the Pokedex table (dex.h, generated by tools/gen_dex.py).
#include "framework.h"
#include "shim/Arduino.h"
#include "../src/dex.h"
#include "../src/i18n.h"
#include "../src/pet.h"
#include <ctype.h>
#include <stdio.h>
#include <string.h>
#include <set>

static const int N = DEX_COUNT;

TEST(dex, table_has_152_entries) {
  CHECK_EQ((int)(sizeof(DEX_TBL) / sizeof(DEX_TBL[0])), N + 1);
  CHECK_EQ((int)(sizeof(DEX_NAME_FR) / sizeof(DEX_NAME_FR[0])), N + 1);
  CHECK_EQ((int)(sizeof(DEX_NAME_DE) / sizeof(DEX_NAME_DE[0])), N + 1);
}

TEST(dex, all_names_are_uppercase_ascii) {
  for (int d = 1; d <= N; d++) {
    const char *n = DEX_TBL[d].name;
    CHECK_MSG(n != NULL && n[0] != 0, "entry without a name");
    if (!n || !n[0]) continue;
    for (const char *c = n; *c; c++) {
      // the firmware's GFX font is ASCII with no lowercase
      CHECK_MSG((unsigned char)*c < 128, std::string("non-ASCII character in ") + n);
      CHECK_MSG(!islower((unsigned char)*c), std::string("lowercase in ") + n);
    }
  }
}

TEST(dex, translated_names_are_ascii_too) {
  const char *const *tables[2] = { DEX_NAME_FR, DEX_NAME_DE };
  for (int t = 0; t < 2; t++) {
    for (int d = 1; d <= N; d++) {
      const char *n = tables[t][d];
      if (!n) continue;  // no name of its own: falls back to DEX_TBL's
      CHECK_MSG(n[0] != 0, "empty translated name");
      for (const char *c = n; *c; c++) {
        CHECK_MSG((unsigned char)*c < 128, std::string("non-ASCII character in ") + n);
        CHECK_MSG(!islower((unsigned char)*c), std::string("lowercase in ") + n);
      }
    }
  }
}

// the card header is char[26] with "%s%s Lv.%u": no name in any
// language may overflow it (the name would be cut off on screen)
TEST(dex, no_name_overflows_the_header) {
  char head[26];
  for (int lang = 0; lang < LANG_COUNT; lang++) {
    gLang = (Lang)lang;
    for (int d = 1; d <= N; d++) {
      int need = snprintf(head, sizeof(head), T(S_NAME_FMT), "*", dexName(d), 255);
      CHECK_MSG(need >= 0 && need < (int)sizeof(head),
                std::string("header truncated: ") + dexName(d));
    }
  }
  gLang = LANG_DEFAULT;
}

TEST(dex, evolutions_point_to_valid_entries) {
  for (int d = 1; d <= N; d++) {
    uint8_t to = DEX_TBL[d].evolvesTo;
    CHECK_MSG(to <= N, std::string("evolvesTo out of range in ") + DEX_TBL[d].name);
    CHECK_MSG(to != d, std::string("evolves into itself: ") + DEX_TBL[d].name);
  }
}

TEST(dex, evolving_and_level_go_together) {
  for (int d = 1; d <= N; d++) {
    bool evolves = DEX_TBL[d].evolvesTo != 0;
    bool hasLevel = DEX_TBL[d].evolveLevel > 0;
    CHECK_MSG(evolves == hasLevel,
              std::string("evolvesTo and evolveLevel do not match in ") + DEX_TBL[d].name);
  }
}

TEST(dex, no_evolution_chain_loops) {
  for (int d = 1; d <= N; d++) {
    std::set<int> seen;
    int cur = d;
    int guard = 0;
    while (cur >= 1 && cur <= N && DEX_TBL[cur].evolvesTo != 0 && guard++ < N) {
      CHECK_MSG(seen.insert(cur).second, std::string("evolution loop in ") + DEX_TBL[d].name);
      if (!seen.count(cur)) break;
      cur = DEX_TBL[cur].evolvesTo;
    }
    CHECK_MSG(guard < 6, std::string("chain too long from ") + DEX_TBL[d].name);
  }
}

TEST(dex, evolution_levels_rise_along_the_chain) {
  for (int d = 1; d <= N; d++) {
    int cur = d, prev = 0, guard = 0;
    while (DEX_TBL[cur].evolvesTo != 0 && guard++ < 6) {
      CHECK_MSG(DEX_TBL[cur].evolveLevel > prev,
                std::string("non-increasing evolution level in ") + DEX_TBL[cur].name);
      prev = DEX_TBL[cur].evolveLevel;
      cur = DEX_TBL[cur].evolvesTo;
    }
  }
}

// a species that only comes from evolution must be reachable from some
// egg, or it would be impossible to register in the pokedex
TEST(dex, every_species_is_reachable) {
  bool reach[DEX_COUNT + 1] = { false };
  for (int d = 1; d <= N; d++) {
    if (DEX_TBL[d].rarity == R_EVO) continue;  // does not hatch from an egg
    int cur = d, guard = 0;
    while (cur >= 1 && cur <= N && guard++ < 6) {
      reach[cur] = true;
      if (cur == DEX_EEVEE) {  // special branch in the game code
        reach[134] = reach[135] = reach[136] = true;
        break;
      }
      if (DEX_TBL[cur].evolvesTo == 0) break;
      cur = DEX_TBL[cur].evolvesTo;
    }
  }
  for (int d = 1; d <= N; d++)
    CHECK_MSG(reach[d], std::string("unreachable: ") + DEX_TBL[d].name);
}

// with the farewell at 3 days (level 72), every line must be able to reach
// its final form before the pet completes its cycle
TEST(dex, every_line_completes_before_the_farewell) {
  const uint32_t maxLevel = FAREWELL_AGE_MIN / MINUTES_PER_LEVEL;
  for (int d = 1; d <= N; d++) {
    if (DEX_TBL[d].rarity == R_EVO) continue;
    int cur = d, guard = 0;
    uint32_t need = 0;
    while (DEX_TBL[cur].evolvesTo != 0 && guard++ < 6) {
      if (DEX_TBL[cur].evolveLevel > need) need = DEX_TBL[cur].evolveLevel;
      cur = DEX_TBL[cur].evolvesTo;
    }
    CHECK_MSG(need <= maxLevel,
              std::string("the line of ") + DEX_TBL[d].name + " does not reach its final form in time");
  }
}

TEST(dex, base_stats_are_plausible) {
  for (int d = 1; d <= N; d++) {
    const DexEntry &e = DEX_TBL[d];
    CHECK_MSG(e.bHp > 0 && e.bAtk > 0 && e.bDef > 0 && e.bSpe > 0,
              std::string("base stat is zero in ") + e.name);
    CHECK_MSG(e.biome <= 5, std::string("unknown biome in ") + e.name);
    CHECK_MSG(e.rarity <= R_LEGENDARY, std::string("unknown rarity in ") + e.name);
  }
}

TEST(dex, eevee_branch_matches_the_code) {
  CHECK_EQ((int)DEX_TBL[DEX_EEVEE].rarity, (int)R_COMMON);
  CHECK_RANGE((int)DEX_TBL[DEX_EEVEE].evolvesTo, 134, 136);
  for (int d = 134; d <= 136; d++) {
    CHECK_EQ((int)DEX_TBL[d].rarity, (int)R_EVO);
    CHECK_EQ((int)DEX_TBL[d].evolvesTo, 0);
  }
}

TEST(dex, classic_starters_are_valid) {
  CHECK_EQ((int)(sizeof(CLASSIC_DEX) / sizeof(CLASSIC_DEX[0])), NUM_CLASSIC_DEX);
  for (int i = 0; i < NUM_CLASSIC_DEX; i++) {
    int16_t d = CLASSIC_DEX[i];
    CHECK_RANGE(d, (int16_t)1, (int16_t)151);
    CHECK_MSG(DEX_TBL[d].rarity != R_EVO, "a starter cannot be an evolved form");
  }
}

TEST(dex, at_least_one_species_per_rarity) {
  int count[4] = { 0, 0, 0, 0 };
  for (int d = 1; d <= N; d++) count[DEX_TBL[d].rarity]++;
  for (int r = 0; r <= R_LEGENDARY; r++)
    CHECK_MSG(count[r] > 0, "a rarity has no species: the egg draw would run out of candidates");
}

// pickEggSpecies puts a tier's candidates in an array of 80: if any
// tier had more, the draw would only cover the first 80
TEST(dex, no_tier_overflows_the_candidate_array) {
  for (int r = R_COMMON; r <= R_LEGENDARY; r++) {
    int n = 0;
    for (int d = 1; d <= N; d++)
      if (DEX_TBL[d].rarity == r) n++;
    CHECK_MSG(n <= 80, "more than 80 candidates in a tier: pickEggSpecies truncates them");
  }
}

TEST(dex, dexName_falls_back_to_base_name_without_translation) {
  gLang = LANG_ES;
  CHECK_STREQ(dexName(1), DEX_TBL[1].name);
  gLang = LANG_FR;
  for (int d = 1; d <= N; d++) {
    const char *want = DEX_NAME_FR[d] ? DEX_NAME_FR[d] : DEX_TBL[d].name;
    CHECK_STREQ(dexName(d), want);
  }
  gLang = LANG_DE;
  for (int d = 1; d <= N; d++) {
    const char *want = DEX_NAME_DE[d] ? DEX_NAME_DE[d] : DEX_TBL[d].name;
    CHECK_STREQ(dexName(d), want);
  }
  gLang = LANG_DEFAULT;
}

TEST(dex, dexName_out_of_range_does_not_blow_up) {
  for (int lang = 0; lang < LANG_COUNT; lang++) {
    gLang = (Lang)lang;
    CHECK_STREQ(dexName(0), DEX_TBL[0].name);
    CHECK_STREQ(dexName(-1), DEX_TBL[0].name);
    CHECK_STREQ(dexName(152), DEX_TBL[0].name);
    CHECK_STREQ(dexName(30000), DEX_TBL[0].name);
  }
  gLang = LANG_DEFAULT;
}
